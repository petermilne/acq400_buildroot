## configs/acq400_main_defconfig
```kconfig
BR2_arm=y
BR2_cortex_a9=y
BR2_ARM_ENABLE_NEON=y
BR2_ARM_ENABLE_VFP=y
BR2_ARM_FPU_VFPV3=y
BR2_SVN="svn"
BR2_JLEVEL=8
BR2_TOOLCHAIN_EXTERNAL=y
BR2_TOOLCHAIN_EXTERNAL_CUSTOM=y
BR2_TOOLCHAIN_EXTERNAL_PATH="/tools/Xilinx/SDK/2018.3/gnu/aarch32/lin/gcc-arm-linux-gnueabi/"
BR2_TOOLCHAIN_EXTERNAL_CUSTOM_PREFIX="arm-linux-gnueabihf"
BR2_TOOLCHAIN_EXTERNAL_GCC_7=y
BR2_TOOLCHAIN_EXTERNAL_HEADERS_4_9=y
BR2_TOOLCHAIN_EXTERNAL_CUSTOM_GLIBC=y
BR2_TOOLCHAIN_EXTERNAL_CXX=y
BR2_TARGET_GENERIC_ISSUE="Welcome to ACQ400"
# BR2_TARGET_GENERIC_REMOUNT_ROOTFS_RW is not set
BR2_ROOTFS_OVERLAY="board/d-tacq/acq400/rootfs-overlay"
BR2_ROOTFS_POST_BUILD_SCRIPT="board/d-tacq/acq400/postbuild.sh"
BR2_ROOTFS_POST_FAKEROOT_SCRIPT="board/d-tacq/acq400/fakeroot.sh"
BR2_ROOTFS_POST_IMAGE_SCRIPT="board/d-tacq/acq400/postimage.sh"
BR2_PACKAGE_BUSYBOX_CONFIG="board/d-tacq/acq400/busybox.config"
BR2_PACKAGE_BUSYBOX_SHOW_OTHERS=y
BR2_PACKAGE_LSOF=y
BR2_PACKAGE_MEMSTAT=y
BR2_PACKAGE_OPROFILE=y
BR2_PACKAGE_PV=y
BR2_PACKAGE_STRACE=y
BR2_PACKAGE_TCF_AGENT=y
BR2_PACKAGE_VALGRIND=y
BR2_PACKAGE_MTD=y
BR2_PACKAGE_GPSD=y
BR2_PACKAGE_GPSD_DEVICES="/dev/ttyPS1"
BR2_PACKAGE_GPSD_UBX=y
BR2_PACKAGE_SEDUTIL=y
BR2_PACKAGE_NODEJS=y
BR2_PACKAGE_NODEJS_NPM=y
BR2_PACKAGE_PYTHON3=y
BR2_PACKAGE_PYTHON3_READLINE=y
BR2_PACKAGE_PYTHON_BITSTRING=y
BR2_PACKAGE_PYTHON_LXML=y
BR2_PACKAGE_PYTHON_NUMPY=y
BR2_PACKAGE_PYTHON_PYEPICS=y
BR2_PACKAGE_PYTHON_PYYAML=y
BR2_PACKAGE_PYTHON_SERIAL=y
BR2_PACKAGE_PYTHON_SETUPTOOLS=y
BR2_PACKAGE_PYTHON_SIMPLEJSON=y
BR2_PACKAGE_PYTHON_SMBUS2=y
BR2_PACKAGE_PYTHON_SPIDEV=y
BR2_PACKAGE_PYTHON_TINYRPC=y
BR2_PACKAGE_PYTHON_WEBSOCKETS=y
BR2_PACKAGE_PYTHON_XLSXWRITER=y
BR2_PACKAGE_PYTHON_ZEROCONF=y
BR2_PACKAGE_TCL=y
# BR2_PACKAGE_TCL_SHLIB_ONLY is not set
BR2_PACKAGE_EXPECT=y
BR2_PACKAGE_TCLX=y
BR2_PACKAGE_LIBGPIOD=y
BR2_PACKAGE_LIBGPIOD_TOOLS=y
BR2_PACKAGE_JQUERY=y
BR2_PACKAGE_TINYXML2=y
BR2_PACKAGE_LIBCURL=y
BR2_PACKAGE_LIBCURL_CURL=y
BR2_PACKAGE_LIBTIRPC=y
BR2_PACKAGE_WEBSOCKETPP=y
BR2_PACKAGE_ZEROMQ_PGM=y
BR2_PACKAGE_ZMQPP=y
BR2_PACKAGE_BOOST=y
BR2_PACKAGE_BOOST_PYTHON=y
BR2_PACKAGE_FFTW=y
BR2_PACKAGE_FFTW_SINGLE=y
BR2_PACKAGE_FFTW_FAST=y
BR2_PACKAGE_MSGPACK=y
BR2_PACKAGE_PCRE_32=y
BR2_PACKAGE_AVAHI=y
BR2_PACKAGE_AVAHI_DAEMON=y
BR2_PACKAGE_DHCPCD=y
BR2_PACKAGE_ETHTOOL=y
BR2_PACKAGE_IPERF=y
BR2_PACKAGE_IPTABLES=y
BR2_PACKAGE_IPTRAF_NG=y
BR2_PACKAGE_LFTP=y
BR2_PACKAGE_LFTP_PROTO_SFTP=y
BR2_PACKAGE_LIGHTTPD=y
BR2_PACKAGE_LIGHTTPD_OPENSSL=y
BR2_PACKAGE_LIGHTTPD_PCRE=y
BR2_PACKAGE_LIGHTTPD_WEBDAV=y
BR2_PACKAGE_LINUXPTP=y
BR2_PACKAGE_MINI_SNMPD=y
# BR2_PACKAGE_NETSNMP_ENABLE_MIBS is not set
BR2_PACKAGE_NETSNMP_WITH_MIB_MODULES="host ucd-snmp/dlmod agentx ucd-snmp/pass ucd-snmp/extensible agent/extend"
BR2_PACKAGE_NGINX=y
BR2_PACKAGE_NGINX_MODSECURITY=y
BR2_PACKAGE_NGINX_UPLOAD=y
BR2_PACKAGE_NTP=y
BR2_PACKAGE_NTP_SNTP=y
BR2_PACKAGE_NTP_NTP_SHM_CLK=y
BR2_PACKAGE_NTP_NTPD_ATOM_PPS=y
BR2_PACKAGE_NTP_NTPDC=y
BR2_PACKAGE_NTP_NTPQ=y
BR2_PACKAGE_NTP_NTPSNMPD=y
BR2_PACKAGE_NTP_NTPTIME=y
BR2_PACKAGE_NTP_TICKADJ=y
BR2_PACKAGE_OPENSSH=y
BR2_PACKAGE_PTPD2=y
BR2_PACKAGE_PURE_FTPD=y
BR2_PACKAGE_SAMBA4=y
BR2_PACKAGE_SHELLINABOX=y
BR2_PACKAGE_SNMPCLITOOLS=y
BR2_PACKAGE_SOCAT=y
BR2_PACKAGE_AT=y
BR2_PACKAGE_INOTIFY_TOOLS=y
BR2_PACKAGE_TTYD=y
BR2_PACKAGE_ATOP=y
BR2_PACKAGE_ACQ400_UTIL=y
BR2_PACKAGE_ACQ400_PROCSERV=y
BR2_PACKAGE_ACQ400_FMC_UTIL=y
BR2_PACKAGE_CKERMIT=y
BR2_PACKAGE_NETKIT_FTP=y
BR2_TARGET_ROOTFS_EXT2=y
BR2_TARGET_ROOTFS_EXT2_LABEL="acq400_main_root"
BR2_TARGET_ROOTFS_EXT2_SIZE="280M"
BR2_TARGET_ROOTFS_TAR_GZIP=y
```

## configs/cpsc2_main_defconfig
```kconfig
BR2_arm=y
BR2_cortex_a9=y
BR2_ARM_ENABLE_NEON=y
BR2_ARM_ENABLE_VFP=y
BR2_ARM_FPU_VFPV3=y
BR2_SVN="svn"
BR2_JLEVEL=8
BR2_TOOLCHAIN_EXTERNAL=y
BR2_TOOLCHAIN_EXTERNAL_CUSTOM=y
BR2_TOOLCHAIN_EXTERNAL_PATH="/tools/Xilinx/SDK/2018.3/gnu/aarch32/lin/gcc-arm-linux-gnueabi/"
BR2_TOOLCHAIN_EXTERNAL_CUSTOM_PREFIX="arm-linux-gnueabihf"
BR2_TOOLCHAIN_EXTERNAL_GCC_7=y
BR2_TOOLCHAIN_EXTERNAL_HEADERS_4_9=y
BR2_TOOLCHAIN_EXTERNAL_CUSTOM_GLIBC=y
BR2_TOOLCHAIN_EXTERNAL_CXX=y
BR2_TARGET_GENERIC_ISSUE="Welcome to ACQ400"
# BR2_TARGET_GENERIC_REMOUNT_ROOTFS_RW is not set
BR2_ROOTFS_OVERLAY="board/d-tacq/acq400/rootfs-overlay"
BR2_ROOTFS_POST_FAKEROOT_SCRIPT="board/d-tacq/acq400/fakeroot.sh"
BR2_ROOTFS_POST_IMAGE_SCRIPT="board/d-tacq/acq400/postimage.sh"
BR2_PACKAGE_BUSYBOX_CONFIG="board/d-tacq/acq400/busybox.config"
BR2_PACKAGE_BUSYBOX_SHOW_OTHERS=y
BR2_PACKAGE_MEMSTAT=y
BR2_PACKAGE_PV=y
BR2_PACKAGE_STRACE=y
BR2_PACKAGE_MTD=y
BR2_PACKAGE_GPSD=y
BR2_PACKAGE_SEDUTIL=y
BR2_PACKAGE_NODEJS=y
BR2_PACKAGE_NODEJS_NPM=y
BR2_PACKAGE_PYTHON_READLINE=y
BR2_PACKAGE_PYTHON_AUTOBAHN=y
BR2_PACKAGE_PYTHON_FLASK_JSONRPC=y
BR2_PACKAGE_PYTHON_FUTURE=y
BR2_PACKAGE_PYTHON_NUMPY=y
BR2_PACKAGE_PYTHON_PYINOTIFY=y
BR2_PACKAGE_PYTHON_PYZMQ=y
BR2_PACKAGE_TCL=y
BR2_PACKAGE_EXPECT=y
BR2_PACKAGE_JQUERY=y
BR2_PACKAGE_TINYXML2=y
BR2_PACKAGE_LIBCURL=y
BR2_PACKAGE_CURL=y
BR2_PACKAGE_LIBTIRPC=y
BR2_PACKAGE_LIBWEBSOCKETS=y
BR2_PACKAGE_FFTW=y
BR2_PACKAGE_FFTW_PRECISION_SINGLE=y
BR2_PACKAGE_FFTW_FAST=y
BR2_PACKAGE_PCRE_32=y
BR2_PACKAGE_DHCPCD=y
BR2_PACKAGE_ETHTOOL=y
BR2_PACKAGE_IPERF=y
BR2_PACKAGE_LIGHTTPD=y
BR2_PACKAGE_LIGHTTPD_OPENSSL=y
BR2_PACKAGE_LIGHTTPD_PCRE=y
BR2_PACKAGE_OPENSSH=y
BR2_PACKAGE_PTPD2=y
BR2_PACKAGE_PURE_FTPD=y
BR2_PACKAGE_SAMBA4=y
BR2_PACKAGE_SHELLINABOX=y
BR2_PACKAGE_SOCAT=y
BR2_PACKAGE_AT=y
BR2_PACKAGE_INOTIFY_TOOLS=y
BR2_PACKAGE_ACQ400_UTIL=y
BR2_PACKAGE_ACQ400_PROCSERV=y
BR2_PACKAGE_ACQ400_FMC_UTIL=y
BR2_PACKAGE_CKERMIT=y
BR2_TARGET_ROOTFS_EXT2=y
BR2_TARGET_ROOTFS_EXT2_LABEL="acq400_main_root"
BR2_TARGET_ROOTFS_EXT2_SIZE="180M"
BR2_TARGET_ROOTFS_TAR_GZIP=y
```

## package/python-pyepics/Config.in
```kconfig
config BR2_PACKAGE_PYTHON_PYEPICS
	bool "python-pyepics"
	help
	  Epics Channel Access for Python.

	  http://pyepics.github.io/pyepics/
```
